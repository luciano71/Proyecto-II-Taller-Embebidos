## build/conf/bblayers.conf
```bitbake
# POKY_BBLAYERS_CONF_VERSION is increased each time build/conf/bblayers.conf
# changes incompatibly
POKY_BBLAYERS_CONF_VERSION = "2"

BBPATH = "${TOPDIR}"
BBFILES ?= ""

BBLAYERS ?= " \
  /home/luciano/poky/meta \
  /home/luciano/poky/meta-poky \
  /home/luciano/poky/meta-yocto-bsp \
  /home/luciano/poky/meta-codigo \
  /home/luciano/poky/meta-openembedded/meta-multimedia \
  /home/luciano/poky/meta-openembedded/meta-oe \
  /home/luciano/poky/meta-openembedded/meta-python \
  /home/luciano/poky/meta-openembedded/meta-filesystems \
  "
```

## meta-codigo/conf/layer.conf
```bitbake
# We have a conf and classes directory, add to BBPATH

BBPATH .= ":${LAYERDIR}"



# We have recipes-* directories, add to BBFILES

BBFILES += "${LAYERDIR}/recipes-*/*.bb \
     ${LAYERDIR}/recipes-*/*/*.bbappend"



BBFILE_COLLECTIONS += "codigo"
BBFILE_PATTERN_codigo = "^${LAYERDIR}/"
BBFILE_PRIORITY_codigo = "5"
LAYERVERSION_codigo = "4"
LAYERSERIES_COMPAT_codigo = "dunfell"
```
